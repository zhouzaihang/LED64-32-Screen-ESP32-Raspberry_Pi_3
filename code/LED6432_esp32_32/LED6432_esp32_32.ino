#define RowA 22
#define RowB 23
#define RowC 21
#define RowD 19
#define OE 18 //EN口

#define R1 17         //数据出    MOSI 输出 main out
#define R2 16
#define G1 2
#define G2 25
#define LE 26       //时钟    SCK
#define CLK 27      //595 刷新显示  SS 片选
//int DATAIN  12     //数据入,读FLASH时有用  MISO 输入 main in

void setup()
{
	pinMode(22, OUTPUT);
	pinMode(23, OUTPUT);
	pinMode(21, OUTPUT);
	pinMode(19, OUTPUT);
	pinMode(18, OUTPUT);
	pinMode(17, OUTPUT);
	pinMode(16, OUTPUT);
	pinMode(2, OUTPUT);
	pinMode(25, OUTPUT);
	pinMode(26, OUTPUT);
	pinMode(27, OUTPUT);
	//初始化引脚
	//Serial.begin(9600);
	digitalWrite(OE, LOW);
	digitalWrite(LE, LOW);
	digitalWrite(CLK, LOW);
}

word Rownumber = 0;

byte ShowR1[16][8] = {
	0x0F,0xFF,0xFF,0xFF,0xFF,0xFF,0xFF,0xFF,
	0xFF,0xFF,0xFF,0xFF,0xFF,0xFF,0xFF,0xFF,
	0xFF,0xFF,0xFF,0xFF,0xFF,0xFF,0xFF,0xFF,
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	0xFF,0xFF,0xFF,0xFF,0xFF,0xFF,0xFF,0xFE
};

byte ShowR2[16][8] = {
	0xFF,0xFF,0xFF,0xFF,0xFF,0xFF,0xFF,0xFF,
	0xFF,0xFF,0xFF,0xFF,0xFF,0xFF,0xFF,0xFF,
	0xFF,0xFF,0xFF,0xFF,0xFF,0xFF,0xFF,0xFF,
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	0xFF,0xFF,0xFF,0xFF,0xFF,0xFF,0xFF,0xFF
};

byte ShowG1[16][8] = {
	0x20,0x80,0x12,0x10,0x20,0x00,0x42,0x00,
	0x3E,0xFE,0x1A,0x18,0x10,0x00,0x22,0x3C,
	0x50,0xA0,0x17,0xD0,0x13,0xFC,0x22,0x24,
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	0xC0,0x04,0x00,0x00,0x00,0x00,0x41,0x08,
};

byte ShowG2[16][8] = {
	0xFF,0xFF,0xFF,0xFF,0xFF,0xFF,0xFF,0xFF,
	0xFF,0xFF,0xFF,0xFF,0xFF,0xFF,0xFF,0xFF,
	0xFF,0xFF,0xFF,0xFF,0xFF,0xFF,0xFF,0xFF,
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	0xFF,0xFF,0xFF,0xFF,0xFF,0xFF,0xFF,0xFF
};

void hc138sacn(word r) {  //输出行线状态ABCD
	digitalWrite(RowA, (r & 0x01));
	digitalWrite(RowB, (r & 0x02));
	digitalWrite(RowC, (r & 0x04));
	digitalWrite(RowD, (r & 0x08));
}

void hc595senddata(byte datar1, byte datar2, byte datag1, byte datag2)
{
	for (byte i = 0; i < 8; i++)
	{
		digitalWrite(R1, datar1 & 0x80);
		datar1 = datar1 << 1;
		digitalWrite(G1, datag1 & 0x80);
		datag1 = datag1 << 1;
		digitalWrite(R2, datar2 & 0x80);
		datar2 = datar2 << 1;
		digitalWrite(G2, datag2 & 0x80);
		datag2 = datag2 << 1;
		digitalWrite(CLK, HIGH);//上升沿发送数据
		digitalWrite(CLK, LOW);
	}
}

void display()
{
	for (Rownumber = 0; Rownumber < 16; Rownumber = Rownumber + 1)
	{
		for (int i = 0; i < 8; i++)
		{
			hc595senddata(ShowR1[Rownumber][i], ShowR2[Rownumber][i], ShowG1[Rownumber][i], ShowG2[Rownumber][i]);
		}
		digitalWrite(OE, HIGH);//关闭LED不仅仅是为了省电，还有清空的作用，这会帮助你解决一些在你看来是玄学的问题，比如为什么我没有给某些点供电，但是某些点却以极其不引人注目的微弱之光闪耀着
		hc138sacn(Rownumber);
		digitalWrite(LE, HIGH);
		digitalWrite(LE, LOW);
		digitalWrite(OE, LOW);
	}
}

// Add the main program code into the continuous loop() function
void loop()
{
	display();
}
